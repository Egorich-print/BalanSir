## buildroot-external/package/balansir/Config.in
```kconfig
config BR2_PACKAGE_BALANSIR
	bool "balansir"
	depends on BR2_INSTALL_LIBSTDCPP
	depends on BR2_TOOLCHAIN_HAS_THREADS
	depends on BR2_PACKAGE_HOST_RUSTC_TARGET_ARCH_SUPPORTS
	select BR2_PACKAGE_HOST_RUSTC
	select BR2_PACKAGE_NFTABLES
	select BR2_PACKAGE_IPROUTE2
	help
	  BalanSir is a network policy engine for Linux routers and
	  gateways: declarative policy, reconcile-driven enforcement,
	  privilege separation between an unprivileged daemon and a
	  privileged nftables executor.

	  https://github.com/Egorich-print/BalanSir

if BR2_PACKAGE_BALANSIR

config BR2_PACKAGE_BALANSIR_OTA
	bool "balansir-ota (A/B update installer)"
	default y
	help
	  Install the balansir-ota binary (A/B slot image installer +
	  boot-switch/confirm/rollback CLI) into /usr/local/bin.

endif

comment "balansir needs a toolchain w/ threads, C++, rustc and nftables"
	depends on !BR2_TOOLCHAIN_HAS_THREADS || !BR2_INSTALL_LIBSTDCPP || !BR2_PACKAGE_HOST_RUSTC_TARGET_ARCH_SUPPORTS
```

## buildroot-external/package/btop/Config.in
```kconfig
config BR2_PACKAGE_BTOP
	bool "btop"
	depends on BR2_INSTALL_LIBSTDCPP
	depends on BR2_TOOLCHAIN_HAS_THREADS
	help
	  btop — resource monitor (CPU, memory, disks, network, processes).

	  https://github.com/aristocratos/btop

comment "btop needs a toolchain w/ C++ and threads"
	depends on !BR2_INSTALL_LIBSTDCPP || !BR2_TOOLCHAIN_HAS_THREADS
```

## buildroot-external/package/fastfetch/Config.in
```kconfig
config BR2_PACKAGE_FASTFETCH
	bool "fastfetch"
	depends on BR2_TOOLCHAIN_HAS_THREADS
	help
	  fastfetch — system information tool (fast, configurable).

	  https://github.com/fastfetch-cli/fastfetch

comment "fastfetch needs a toolchain w/ threads"
	depends on !BR2_TOOLCHAIN_HAS_THREADS
```

## buildroot-external/package/xray/Config.in
```kconfig
config BR2_PACKAGE_XRAY_CORE
	bool "xray-core"
	depends on BR2_PACKAGE_HOST_GO_TARGET_ARCH_SUPPORTS
	select BR2_PACKAGE_HOST_GO
	help
	  Xray-core — the proxy runtime BalanSir's VPN pool drives
	  (VLESS outbounds with tcp/ws/grpc/httpupgrade transports).

	  https://github.com/XTLS/Xray-core
```
